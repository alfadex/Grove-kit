#include <U8g2lib.h>
#include <Arduino.h>
#include "DHT.h"

const int btnPin = 6;                             //Pin button for change cases
const int ledPin = 4;                             //Pin for led
int selector = 0;                                 //var for change cases in switch-case
DHT dht(3, DHT11);                                //temperature sensor connected to pin D3

//initialize our dipslay through i2c
U8G2_SSD1306_128X64_NONAME_F_HW_I2C u8g2(U8G2_R2, /* reset=*/ U8X8_PIN_NONE);

u8g2_uint_t offset;                               // current offset for the scrolling text
u8g2_uint_t width;                                // pixel width of the scrolling text
const char *text = "Hello";                       // scroll this text from right to left

void setup() {
  u8g2.begin();                                   //initialize display
  Serial.begin(9600);
  pinMode(btnPin, INPUT_PULLUP);
  pinMode(ledPin, OUTPUT);
  u8g2.setFont(u8g2_font_inb30_mr);              // set the target font to calculate the pixel width
  width = u8g2.getUTF8Width(text);               // calculate the pixel width of the text
  u8g2.setFontMode(0);                           // enable transparent mode, which is faster
}

void loop () {                                    //loop,check if button is pressed and somde code for scrolling text

  if (digitalRead(btnPin) == HIGH ) //if button is pressed
  {
    digitalWrite(ledPin, HIGH);                  //Led on
    delay(300);
    digitalWrite(ledPin, LOW);                   //Led off
    delay(300);
    Serial.print(selector);
    SwitchStatement();                           //Call this function that incude switch-case
    selector++;                                  //switch case variable,add 1 each time btn pressed to move to next case
    if (selector > 3) {                          //When reach case 3, start from case 0(beginning)
      selector = 0;
    }
  }

  //this statement is used for Scrolling Text.Checking if Switch-Case selector is equal 3.Is so ,scroll text (case 2)
  if (selector == 3) {
    u8g2_uint_t x;
    u8g2.firstPage();
    do {                                                 // draw the scrolling text at current offset
      x =  offset;
      u8g2.setFont(u8g2_font_ncenB12_tr);        // set the target font
      do {                                       // repeated drawing of the scrolling text...
        u8g2.drawUTF8(x, 30, text);              // draw the scolling text
        x = x + (width);                         // add the pixel width of the scrolling text
      } while ( x < u8g2.getDisplayWidth() );    // draw again until the complete display is filled
    } while ( u8g2.nextPage() );
    offset -= 1;                                 // scroll by one pixel
    if ( (u8g2_uint_t)offset < (u8g2_uint_t) - width )
      offset = 0;                                // start over again
    delay(10);                                   // do some small delay
  }
}

// this is eyes.xbm made with GIMP
const unsigned char eyes[] U8X8_PROGMEM = {
  0xff, 0xff, 0xff, 0xff, 0xff, 0xff, 0xff, 0xff, 0xff, 0xff, 0xff, 0xff,
  0xff, 0xff, 0xff, 0xff, 0xff, 0xff, 0xff, 0xff, 0xff, 0xff, 0xff, 0xff,
  0xff, 0xff, 0xff, 0xff, 0xff, 0xff, 0xff, 0xff, 0xff, 0xff, 0xff, 0xff,
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  0xff, 0xff, 0xff, 0xff, 0xff, 0xff, 0xff, 0xff
};

void SwitchStatement() {                          //SwitchStatement function, called in loop
  int temp = 0;                                   //int temp need for case 3
  int humid = 0;                                  //int temp need for case 3
  temp = dht.readTemperature();                   //save temperature value in temp var
  humid = dht.readHumidity();                     //save humidity value in humid var
  switch (selector) {                             //start switch-case statement

    //print Hello World
    case 0:                                       //run when selector var is equal 0, check in loop
      u8g2.firstPage();
      do {
        u8g2.drawRFrame(36, 8, 50, 25, 5);        //column,line,width,heigh,corner curve
        u8g2.setFont(u8g2_font_ncenB08_tr);
        u8g2.drawStr(45, 25, "Case 0");           //column,line,String
        u8g2.drawStr(25, 48, "Print a string");   //column,line,String
        u8g2.sendBuffer();                        //transfer arduino RAM to the display.
        Serial.print("Case ");
        Serial.print(selector);
        Serial.println(": print Hello World");
        delay(2500);
        u8g2.clearBuffer();                       //clear buffer on display
        u8g2.setFont(u8g2_font_ncenB14_tr);
        u8g2.drawStr(6, 40, "Hello World");       //column,line,String
        delay(100);
      } while (u8g2.nextPage() );
      break;

    //Show an image
    case 1:                                       //run when selector var is equal 1, check in loop
      u8g2.firstPage();
      do {
        u8g2.drawRFrame(36, 8, 50, 25, 5);        //column,line,width,heigh,corner curve
        u8g2.setFont(u8g2_font_ncenB08_tr);
        u8g2.drawStr(45, 25, "Case 1");           //column,line,String
        u8g2.drawStr(25, 48, "Show image");       //column,line,String
        u8g2.sendBuffer();                        //transfer the arduino RAM to the display.
        delay(2500);
        u8g2.clearBuffer();                       //clear buffer on display
        u8g2.setFont(u8g2_font_ncenB14_tr);
        u8g2.drawStr(0, 5, "Case 1!");            //column,line,String
        u8g2.clearBuffer();                       //clear buffer on display
        u8g2.setFont(u8g2_font_ncenB08_tr);
        u8g2.drawXBMP(0, 0, 128, 74, eyes);       //column,line,width,heigh,file name(eyes.xbm)
        u8g2.sendBuffer();                        //transfer arduino RAM to the display.
        Serial.print("Case ");
        Serial.print(selector);
        Serial.println(": print XBMP");
        delay(100);
      } while (u8g2.nextPage() );
      break;

    //Print Scrolling text, it run in loop when selector is equal 3
    case 2:                                       //run when selector var is equal 2, check in loop
      u8g2.firstPage();
      do {
        u8g2.drawRFrame(36, 8, 50, 25, 5);        //column,line,width,heigh,corner curve
        u8g2.setFont(u8g2_font_ncenB08_tr);
        u8g2.drawStr(45, 25, "Case 2");           //column,line,String
        u8g2.drawStr(25, 48, "Scrolling Text");   //column,line,String
        u8g2.sendBuffer();                        //transfer the arduino RAM to the display.
        delay(2500);
        Serial.print("Case ");
        Serial.print(selector);
        Serial.println(": print Scrolling Text");
        delay(100);
      } while (u8g2.nextPage() );
      break;

    //Print temperature,humidity
    case 3:
      u8g2.firstPage();
      do {
        u8g2.drawRFrame(36, 8, 50, 25, 5);      //column,line,width,heigh,corner curve
        u8g2.setFont(u8g2_font_ncenB08_tr);
        u8g2.drawStr(45, 25, "Case 3");         //column,line,String
        u8g2.drawStr(0, 48, "Temperature-Humidity");    //column,line,String
        u8g2.sendBuffer();                      //transfer the arduino RAM to the display.
        Serial.print("Case ");
        Serial.print(selector);
        Serial.println(": Temperature");
        delay(2500);
        u8g2.clearBuffer();                     //clear buffer on display
        u8g2.setFont(u8g2_font_t0_16b_mr);
        u8g2.setCursor(0, 18);                  //column,line for "temp"
        u8g2.print("temperature:");
        u8g2.setCursor(96, 18);                 //column,line for value temp
        u8g2.print(temp);
        u8g2.setCursor(112, 20);                //column,line for "C"
        u8g2.print("C");
        u8g2.setCursor(0, 48);                  //column,line for "humid"
        u8g2.print("humidity:");
        u8g2.setCursor(72, 48);                 //column,line for value humid
        u8g2.print(humid);
        u8g2.drawLine(0, 0, 128, 0);            //column start,line start,column stop,line stop  **  upper line
        u8g2.drawLine(0, 60, 128, 60);          //column start,line start,column stop,line stop  **  middle line
        u8g2.drawLine(25, 28, 103, 28);         //column start,line start,column stop,line stop  **  lower line
       } while (u8g2.nextPage() );
      break;
  }                                             //end switch-case statement
}  //finish SwitchStatment
